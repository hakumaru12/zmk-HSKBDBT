## boards/shields/hskbdbt/Kconfig.defconfig
```kconfig
if SHIELD_HSKBDBT_LEFT

config ZMK_KEYBOARD_NAME
    default "HSKBDBT"

config ZMK_SPLIT_ROLE_CENTRAL
    default y

endif # SHIELD_HSKBDBT_LEFT

if SHIELD_HSKBDBT_LEFT || SHIELD_HSKBDBT_RIGHT

config ZMK_SPLIT
    default y

config NFCT_PINS_AS_GPIOS
    default y

endif # SHIELD_HSKBDBT_LEFT || SHIELD_HSKBDBT_RIGHT
```

## boards/shields/hskbdbt/Kconfig.shield
```kconfig
config SHIELD_HSKBDBT_LEFT
    def_bool $(shields_list_contains,hskbdbt_left)

config SHIELD_HSKBDBT_RIGHT
    def_bool $(shields_list_contains,hskbdbt_right)
```
